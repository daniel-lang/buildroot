## package/cpuinfo/Config.in
```kconfig
config BR2_PACKAGE_CPUINFO_ARCH_SUPPORTS
	bool
	default y if BR2_aarch64
	default y if BR2_arm
	default y if BR2_i386
	default y if BR2_x86_64

config BR2_PACKAGE_CPUINFO
	bool "cpuinfo"
	depends on BR2_PACKAGE_CPUINFO_ARCH_SUPPORTS
	depends on BR2_TOOLCHAIN_HAS_THREADS
	depends on BR2_TOOLCHAIN_USES_GLIBC # sys/auxv.h
	help
	  CPU INFOrmation library, cpuinfo is a library to detect
	  essential for performance optimization information about
	  host CPU.

	  https://github.com/pytorch/cpuinfo

comment "cpuinfo needs a glibc toolchain w/ threads"
	depends on BR2_PACKAGE_CPUINFO_ARCH_SUPPORTS
	depends on !BR2_TOOLCHAIN_HAS_THREADS \
		|| !BR2_TOOLCHAIN_USES_GLIBC
```
